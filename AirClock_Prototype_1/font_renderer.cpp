// include header
#include "font_renderer.h"

// font lookup table
static const uint8_t PROGMEM FONT[59][5] = {
  {0x00,0x00,0x00,0x00,0x00},
  {0x00,0x00,0x5F,0x00,0x00},
  {0x00,0x00,0x00,0x00,0x00},
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  {0x61,0x51,0x49,0x45,0x43},
};


static const uint16_t PROGMEM ICON_A[ICON_COUNT][9] = {
  {0x010,0x082,0x038,0x07C,0x17D,0x07C,0x038,0x082,0x010},
  {0x030,0x060,0x0E0,0x1E0,0x1E0,0x1E0,0x0F0,0x07C,0x038},
  {0x000,0x000,0x000,0x003,0x007,0x00F,0x01F,0x01F,0x00E},
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  {0x010,0x092,0x054,0x038,0x1FF,0x038,0x054,0x092,0x010},
};

static const uint16_t PROGMEM ICON_B[ICON_COUNT][9] = {
  {0x000,0x000,0x000,0x000,0x000,0x000,0x000,0x000,0x000},
  {0x000,0x000,0x000,0x000,0x000,0x000,0x000,0x000,0x000},
  {0x020,0x088,0x070,0x170,0x070,0x000,0x000,0x000,0x000},
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  {0x000,0x000,0x000,0x000,0x000,0x000,0x000,0x000,0x000},
};

static const int LOGO_COLS = 17;
static const int LOGO_ROWS = 13;

static const uint32_t PROGMEM LOGO_A[LOGO_ROWS] = {0x00300,0x00FC0,0x01FE0,0x01FE0,0x07FF0,0x0FFC0,0x1FF80,0x1FF00,0x1FF00,0x1FF00,0x0FF00,0x00000,0x00000};

static const uint32_t PROGMEM LOGO_B[LOGO_ROWS] = {0x00000,0x00000,0x00000,0x00000,0x00000,0x00000,0x0001C,0x00036,0x00077,0x00077,0x0007B,0x0003E,0x0001C};

int dot_radius(int pitch) {
  if (pitch <= 2) return 0;
  int r = (pitch * 35) / 100;
  return r < 1 ? 1 : r;
}

struct GlyphInfo {
  const uint8_t *cols;
  uint8_t first;
  uint8_t count;
};

static bool glyph_info(uint8_t c, GlyphInfo *gi) {
  if (c >= 0x80) return false;
  if (c >= 'a' && c <= 'z') c -= 32;
  if (c < 32 || c > 90) return false;

  const uint8_t *g = FONT[c - 32];
  gi->cols = g;
  gi->first = 0;
  gi->count = 5;

  if (c == ' ') {
    gi->cols = nullptr;
    gi->count = 3;
    return true;
  }
  if (c == ':' || c == '.' || c == ',' || c == '!' || c == '*' || c == '\'') {
    int first = -1, last = -1;
    for (int i = 0; i < 5; i++) {
      if (pgm_read_byte(&g[i])) {
        if (first < 0) first = i;
        last = i;
      }
    }
    if (first >= 0) {
      gi->first = (uint8_t)first;
      gi->count = (uint8_t)(last - first + 1);
    }
  }
  return true;
}

int dot_text_width(const char *text, int pitch) {
  int cols = 0, n = 0;
  for (const uint8_t *p = (const uint8_t *)text; *p; p++) {
    GlyphInfo gi;
    if (!glyph_info(*p, &gi)) continue;
    cols += gi.count;
    n++;
  }
  if (n == 0) return 0;
  return (cols + n - 2) * pitch + 2 * dot_radius(pitch) + 1;
}

int dot_text_height(int pitch) { return 6 * pitch + 2 * dot_radius(pitch) + 1; }
int dot_icon_size(int pitch)   { return 8 * pitch + 2 * dot_radius(pitch) + 1; }

void dot_text(Adafruit_GFX *gfx, const char *text, int x, int y, int pitch, uint16_t color) {
  const int r = dot_radius(pitch);
  int cx = x;

  for (const uint8_t *p = (const uint8_t *)text; *p; p++) {
    GlyphInfo gi;
    if (!glyph_info(*p, &gi)) continue;

    if (gi.cols) {
      for (int col = 0; col < gi.count; col++) {
        uint8_t bits = pgm_read_byte(&gi.cols[gi.first + col]);
        for (int row = 0; row < 7; row++) {
          if (bits & (1 << row)) {
            gfx->fillCircle(cx + col * pitch + r, y + row * pitch + r, r, color);
          }
        }
      }
    }
    cx += (gi.count + 1) * pitch;
  }
}

void dot_icon(Adafruit_GFX *gfx, WeatherIcon icon, int x, int y, int pitch, uint16_t color_a, uint16_t color_b) {
  if (icon >= ICON_COUNT) return;
  const int r = dot_radius(pitch);

  for (int row = 0; row < 9; row++) {
    uint16_t a = pgm_read_word(&ICON_A[icon][row]);
    uint16_t b = pgm_read_word(&ICON_B[icon][row]);
    if (!(a | b)) continue;
    for (int col = 0; col < 9; col++) {
      const uint16_t m = 1 << (8 - col);
      if (a & m)      gfx->fillCircle(x + col * pitch + r, y + row * pitch + r, r, color_a);
      else if (b & m) gfx->fillCircle(x + col * pitch + r, y + row * pitch + r, r, color_b);
    }
  }
}

int dot_logo_width(int pitch)  { return (LOGO_COLS - 1) * pitch + 2 * dot_radius(pitch) + 1; }
int dot_logo_height(int pitch) { return (LOGO_ROWS - 1) * pitch + 2 * dot_radius(pitch) + 1; }

void dot_logo(Adafruit_GFX *gfx, int x, int y, int pitch, uint16_t color_cloud, uint16_t color_clock) {
  const int r = dot_radius(pitch);

  for (int row = 0; row < LOGO_ROWS; row++) {
    const uint32_t a = pgm_read_dword(&LOGO_A[row]);
    const uint32_t b = pgm_read_dword(&LOGO_B[row]);
    if (!(a | b)) continue;
    for (int col = 0; col < LOGO_COLS; col++) {
      const uint32_t m = 1UL << (LOGO_COLS - 1 - col);
      if (a & m)      gfx->fillCircle(x + col * pitch + r, y + row * pitch + r, r, color_cloud);
      else if (b & m) gfx->fillCircle(x + col * pitch + r, y + row * pitch + r, r, color_clock);
    }
  }
}